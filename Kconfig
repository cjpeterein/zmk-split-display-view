## Kconfig
```kconfig
# SPDX-License-Identifier: MIT

config ZMK_SPLIT_DISPLAY_VIEW
    bool "zmk-dongle-display-view style status screen on a split peripheral"
    depends on ZMK_DISPLAY_STATUS_SCREEN_CUSTOM && ZMK_SPLIT_BLE && !ZMK_SPLIT_ROLE_CENTRAL
    select BT_L2CAP_DYNAMIC_CHANNEL
    select LV_USE_IMG
    select LV_USE_CANVAS
    select LV_FONT_UNSCII_8
    select LV_FONT_MONTSERRAT_16

if ZMK_SPLIT_DISPLAY_VIEW

config ZMK_SPLIT_DISPLAY_VIEW_ROTATE_CCW
    bool "Rotate the portrait screen counterclockwise instead of clockwise"

config ZMK_SPLIT_DISPLAY_VIEW_MAC_MODIFIERS
    bool "Use macOS modifier symbols"

config ZMK_SPLIT_DISPLAY_VIEW_SLOT0_LABEL
    string "Battery label of the first peripheral the central paired"
    default "L"

config ZMK_SPLIT_DISPLAY_VIEW_SLOT1_LABEL
    string "Battery label of the second peripheral the central paired"
    default "R"

config ZMK_SPLIT_DISPLAY_VIEW_CENTRAL_BATTERY
    bool "Show the battery level of the central"

endif

config ZMK_SPLIT_DISPLAY_VIEW_CENTRAL
    bool "Send the status shown by zmk-split-display-view peripherals"
    depends on ZMK_SPLIT_BLE && ZMK_SPLIT_ROLE_CENTRAL
    default y
    select BT_L2CAP_DYNAMIC_CHANNEL
    imply ZMK_WPM
    imply ZMK_HID_INDICATORS
    imply ZMK_SPLIT_BLE_CENTRAL_BATTERY_LEVEL_FETCHING if ZMK_BATTERY_REPORTING
```
